## boards/duebon/tec0097/Kconfig.tec0097
```kconfig
# SPDX-License-Identifier: Apache-2.0

config BOARD_TEC0097
	select SOC_XILINX_XC7Z015
```

## boards/duebon/tec0097/board.yml
```yaml
board:
  name: tec0097
  full_name: ZYNQ PCIe Board
  vendor: duebon
  socs:
  - name: xc7z015
```

## boards/duebon/tec0097/tec0097_defconfig
```kconfig
# SPDX-License-Identifier: Apache-2.0

CONFIG_ROMSTART_RELOCATION_ROM=y

# The GTC is always clocked at 1/2 of the CPU frequency (CPU_3x2x)
CONFIG_ARM_ARCH_TIMER=y
CONFIG_SYS_CLOCK_HW_CYCLES_PER_SEC=333333343

CONFIG_SYSCON=y

CONFIG_PINCTRL=y

CONFIG_REMOTEPROC=y

CONFIG_OPENAMP_MASTER=n

#shared memory is places OCM, no need for caching
CONFIG_OPENAMP_WITH_DCACHE=n


CONFIG_MBOX=y

CONFIG_RAM_CONSOLE=y

CONFIG_RAM_CONSOLE_BUFFER_SECTION=y

CONFIG_LOG_BACKEND_RPMSG=y
```

## drivers/Kconfig
```kconfig
# SPDX-License-Identifier: Apache-2.0

menu "Drivers"
rsource "mbox/Kconfig"
endmenu
```

## drivers/mbox/Kconfig
```kconfig
# SPDX-License-Identifier: Apache-2.0

config MBOX_MAUSYS_PCI
	bool "FPFA mailbox"
	default y
	depends on DT_HAS_MAUSYS_MBOX_PCI_ENABLED
	help
	  Driver for FPGA Mailbox
```

## drivers/remoteproc/Kconfig
```kconfig
# SPDX-License-Identifier: Apache-2.0

menuconfig REMOTEPROC
	bool "OpenAMP RemoteProc Device Driver"
	  
if REMOTEPROC

config OPENAMP_RESOURCE_TABLE
        bool "openamp resource table"
        imply OPENAMP
        default y
        depends on DT_HAS_OPENAMP_RESOURCE_TABLE_ENABLED
        help
          add the resource table in the generated binary. This table is
          compatible with linux remote proc framework and OpenAMP library.

config OPENAMP_RPMSG_VDEV
        bool "OpenAMP RPMSG VirtIO Device"
        imply OPENAMP
        default y
        depends on DT_HAS_OPENAMP_RPMSG_VIRTIO_DEVICE_ENABLED
        help
          Driver for the OpenAMP RPMSG VirtIO Device.

config RPMSG_VDEV_INIT_PRIORITY
	int "RemoteProc init priority"
	default 40
	help
	  RemoteProc initialization priority.

config RPMSG_VDEV_THREAD_STACK_SIZE
        int "OpenAMP RPMSG VirtIO driver internal thread stack size"
        default 2048
        depends on OPENAMP_RPMSG_VDEV
        help
          Size of the stack used in the driver.

config RPMSG_VDEV_THREAD_PRIORITY
        int "OpenAMP RPMSG VirtIO driver thread priority"
        default 8
        depends on OPENAMP_RPMSG_VDEV
        help
          RPMSG VirtIO driver thread priority.

module = RPROC
module-str = rproc
source "subsys/logging/Kconfig.template.log_config"

endif # REMOTEPROC
```

## dts/bindings/mbox/mausys,pci-mbox.yaml
```yaml
description: 
  FPGA Mailbox using the axi_msic (AXI-Interface) and axi_intc (interrupt only)

compatible: "mausys,mbox-pci"

include: [base.yaml, mailbox-controller.yaml]

properties:
  reg:
    required: true

  interrupts:
    required: true

  msi-vector:
    type: int
    default: 0

mbox-cells:
  - channel
```

## logging/Kconfig
```kconfig
# SPDX-License-Identifier: Apache-2.0

config LOG_BACKEND_RPMSG
	bool "OpenAMP RPMSG backend"

if LOG_BACKEND_RPMSG

backend = RPMSG
backend-str = rpmsg
source "subsys/logging/Kconfig.template.log_format_config"

endif # LOG_BACKEND_RPMSG
```
